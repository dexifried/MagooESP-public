#pragma once
#include <Arduino.h>
const char DASHBOARD_PAGE[] PROGMEM = R"MAGOOHTML(<!doctype html><html lang="en"><head><meta charset="utf-8"><meta name="viewport" content="width=device-width,initial-scale=1"><meta name="theme-color" content="#0d0e0f"><title>Magoo Control Center</title><style>
:root{color-scheme:dark;--red:#f1313a;--muted:#a5a7a9;--line:#37393b}*{box-sizing:border-box}body{margin:0;background:#090a0b;color:#f6f6f6;font-family:system-ui,-apple-system,Segoe UI,sans-serif}main{max-width:560px;margin:auto;padding:0 14px 32px}.hero{height:205px;margin:0 -14px 16px;padding:54px 27px 20px;background:linear-gradient(90deg,rgba(7,8,9,.72),rgba(7,8,9,.1)),linear-gradient(0deg,#090a0b,transparent 70%),url('/hero.jpg') center 53%/cover}.brand{font-size:48px;font-weight:900;letter-spacing:-3px;font-style:italic;line-height:1}.subbrand{font-size:11px;letter-spacing:4px;font-weight:700;margin-top:7px}.tagline{font-size:10px;color:#c0c0c0;letter-spacing:2.5px;margin-top:20px}.card{background:linear-gradient(145deg,#1b1c1e,#141517);border:1px solid #323436;border-radius:13px;margin:10px 0;padding:16px}.row{display:flex;align-items:center;gap:13px}.ico{display:grid;place-items:center;flex:none;width:38px;height:38px;border:1px solid #55585a;border-radius:9px;color:#f3f3f3}.ico svg,.glyph{width:22px;height:22px;fill:none;stroke:currentColor;stroke-width:1.7;stroke-linecap:round;stroke-linejoin:round}.meta{flex:1;min-width:0}.title{font-weight:700;font-size:15px}.caption{color:var(--muted);font-size:12px;line-height:1.45;margin-top:3px}.connection{font-size:12px;color:#ee656b;margin-top:3px}.connection.online{color:#83d8a8}.dot{display:inline-block;width:8px;height:8px;border-radius:50%;background:#ef3d45;margin-right:5px}.online .dot{background:#58d692}.power-button{display:grid;place-items:center;flex:none;width:46px;height:46px;border:1px solid #4a4c4e;border-radius:50%;background:#1c1e1e;color:#a4a9a6;cursor:pointer;transition:color .2s,border-color .2s,background .2s}.power-button.on{color:#61df97;border-color:#3b865d;background:#14261d}.power-button.standby{color:#ffad4b;border-color:#a5672d;background:#2a2118}.power-button:disabled{opacity:.55;cursor:default}.power-button:focus-visible{outline:2px solid #fff;outline-offset:3px}.power-button svg{width:23px;height:23px;fill:none;stroke:currentColor;stroke-width:2;stroke-linecap:round;stroke-linejoin:round}.chev{color:#dadada;font-size:23px}.themes{display:grid;grid-template-columns:repeat(4,minmax(0,1fr));gap:12px 8px;margin-top:15px;padding-bottom:3px}.theme{border:0;padding:0;background:transparent;color:#c8c8c8;text-align:center;font:inherit;font-size:clamp(9px,2.7vw,11px);cursor:pointer}.preview{height:76px;border:1px solid #555;border-radius:8px;background:radial-gradient(ellipse at 50% 115%,#2d3133,#08090a 70%);display:flex;flex-direction:column;align-items:center;justify-content:center;gap:0;position:relative}.preview:before{content:'';position:absolute;top:10px;width:46px;height:28px;border:3px solid var(--accent);border-bottom:0;border-radius:50px 50px 0 0;opacity:.85}.preview strong{font-size:20px;margin-top:12px;line-height:1}.preview small{font-size:7px}.theme span.label{display:block;margin-top:6px;white-space:nowrap}.theme.selected .preview{border:2px solid var(--red)}.theme.selected .label{color:#ff555d;font-weight:700}.view-grid,.planned-list{display:grid;grid-template-columns:repeat(4, minmax(0,72px));gap:14px;margin-top:14px}.view-choice,.planned-tile{min-width:0;background:transparent;border:0;color:#eee;text-align:center;padding:0;cursor:pointer}.planned-tile{cursor:default}.app-icon{display:block;width:100%;aspect-ratio:1;border:1px solid #48494b;border-radius:14px;background-repeat:no-repeat;background-size:cover;background-position:center}.app-icon.speed{background-image:url('/speed.jpg')}.app-icon.nav{background-image:url('/navigation.jpg')}.app-icon.music{background-image:url('/music.jpg')}.app-icon.home{background-image:url('/home.jpg')}.app-icon.tilt{display:grid;place-items:center;background:radial-gradient(circle at 45% 30%,#424449,#101113 70%);box-shadow:inset 0 0 0 2px #515357,inset 0 -3px 8px #640d14}.app-icon.battery{background-position:100% 0%}.app-icon.wheel{background-position:0% 100%}.app-icon.update{background-position:50% 100%}.view-choice.selected .app-icon{outline:2px solid var(--red);outline-offset:1px}.view-choice strong,.planned-tile strong{display:block;font-size:10px;line-height:1.3;margin-top:6px;overflow-wrap:anywhere}.planned-tile small{display:block;color:var(--muted);font-size:10px;margin-top:3px}.planned{border-top:1px solid #353638;margin-top:17px;padding-top:13px}.sliderhead{display:flex;align-items:center;gap:11px}.toggle{display:flex;align-items:center;gap:7px;font-size:12px}.toggle input{accent-color:var(--red);width:19px;height:19px}.range{width:100%;accent-color:var(--red);margin:20px 0 4px}.scale{display:flex;justify-content:space-between;color:#aaa;font-size:11px}.value{text-align:center;font-weight:700;font-size:17px;margin-top:3px}.actions{display:flex;gap:8px;margin-top:14px}button,.button,select,input[type=password]{font:inherit}button.action,.button{border:1px solid #494b4d;background:#252628;color:#f5f5f5;border-radius:8px;padding:10px 13px;cursor:pointer;text-decoration:none;display:inline-block;font-size:13px;font-weight:650}.action.primary{background:#bc2028;border-color:#bc2028}.mirror-home-row{display:flex;justify-content:center;margin-top:12px}.mirror-home-button{display:grid;place-items:center;width:44px;height:44px;background:#252628;border:1px solid #494b4d;border-radius:50%;color:#fff;cursor:pointer}.mirror-home-button svg{width:22px;height:22px;fill:none;stroke:currentColor;stroke-width:1.8;stroke-linecap:round;stroke-linejoin:round}.gps-panel{margin-top:14px;border-radius:9px;min-height:92px;border:1px solid #404548;background:linear-gradient(130deg,#253333,#202a2b 45%,#171c1e);display:flex;align-items:center;justify-content:center;text-align:center;padding:18px;color:#d5dddd;font-size:13px}.tiles{display:grid;grid-template-columns:1fr;gap:10px}.tile{margin:0}.click{cursor:pointer}.tile .ico{border:0;width:30px;height:30px}.tile .title{font-size:14px}.tile .row{min-height:42px}.tile.button{font-weight:400}.tile .caption{font-weight:400}details>summary{list-style:none;cursor:pointer}details>summary::-webkit-details-marker{display:none}details[open] summary .chev{transform:rotate(90deg)}.setup{padding-top:15px}.field{display:block;font-size:12px;font-weight:650;margin:13px 0 6px;color:#d7d7d7}select,input[type=password]{width:100%;background:#101113;border:1px solid #505254;border-radius:8px;color:white;padding:12px;min-height:44px}.note{font-size:12px;line-height:1.5;color:#adafb0}.message{min-height:18px;font-size:12px;color:#c6c9c9}.gps-on{color:#7ed5a6}.footer{padding:12px 4px 0;color:#818487;font-size:11px;line-height:1.5}.footer:empty{display:none}.sr{position:absolute;left:-10000px}@media(max-width:360px){.hero{height:185px}.tiles{grid-template-columns:1fr}.brand{font-size:42px}}

#winch-out,#winch-in,#winch-out *,#winch-in *{-webkit-user-select:none;user-select:none;-webkit-touch-callout:none;-webkit-tap-highlight-color:transparent;touch-action:none}
</style><style>/* The pairing flow is intentionally separate from the dashboard controls. */
:root{--pair-accent:#ef3038;--pair-ink:#fff}
#pairing{box-sizing:border-box;border:0;padding:0;background:#0a0b0d;color:#f5f5f5;position:fixed;inset:0;width:100%;height:100%;max-width:none;max-height:none;margin:0;overflow:auto;font:inherit}
#pairing:not([open]){display:none}#pairing::backdrop{background:rgba(0,0,0,.8)}
.pair-shell{min-height:100%;max-width:500px;margin:auto;display:flex;flex-direction:column;padding:calc(12px + env(safe-area-inset-top)) 22px calc(24px + env(safe-area-inset-bottom))}
.pair-top{display:grid;grid-template-columns:44px 1fr 44px;align-items:center;min-height:52px;margin-bottom:20px}.pair-top strong{text-align:center;font-size:16px;letter-spacing:-.01em}.pair-icon-button{width:44px;height:44px;border:0;background:none;color:#f5f5f5;display:grid;place-items:center;border-radius:12px;cursor:pointer}.pair-icon-button svg,.pair-icon svg,.pair-chevron svg{width:24px;height:24px;fill:none;stroke:currentColor;stroke-width:1.8;stroke-linecap:round;stroke-linejoin:round}.pair-icon-button:focus-visible,.pair-choice:focus-visible,.pair-primary:focus-visible,.pair-secondary:focus-visible{outline:2px solid var(--pair-accent);outline-offset:3px}
.pair-screen{flex:1;display:flex;flex-direction:column}.pair-screen[hidden]{display:none}.pair-intro{text-align:center;padding:16px 4px 6px}.pair-mark{width:88px;height:88px;border-radius:28px;margin:0 auto 25px;display:grid;place-items:center;background:linear-gradient(145deg,#261719,#151416);border:1px solid #493035;color:var(--pair-accent);box-shadow:0 16px 50px rgba(0,0,0,.25)}.pair-mark svg{width:42px;height:42px;fill:none;stroke:currentColor;stroke-width:1.7;stroke-linecap:round;stroke-linejoin:round}.pair-mark.good{color:var(--pair-accent)}.pair-screen h1{font-size:30px;line-height:1.1;letter-spacing:-.035em;margin:0 0 12px}.pair-lead{font-size:15px;line-height:1.5;color:#aaaeb1;margin:0}.pair-intro .pair-lead{max-width:340px;margin:auto}.pair-list{display:grid;gap:10px;margin-top:28px}.pair-choice{display:flex;gap:15px;align-items:center;width:100%;min-height:76px;text-align:left;padding:14px 16px;border:1px solid #35373a;border-radius:15px;color:#f5f5f5;background:linear-gradient(135deg,#1c1d1f,#151618);cursor:pointer;font:inherit}.pair-choice[aria-pressed=true]{border-color:var(--pair-accent);background:#211719}.pair-choice:disabled{opacity:.55;cursor:wait}.pair-icon{flex:none;color:var(--pair-accent);display:grid;place-items:center;width:32px}.pair-copy{min-width:0;flex:1}.pair-copy strong{display:block;font-size:16px;font-weight:650;overflow-wrap:anywhere}.pair-copy small{display:block;margin-top:4px;font-size:12px;line-height:1.3;color:#a5a8aa}.pair-chevron{color:#a8a8aa;display:grid;place-items:center}.pair-chevron svg{width:20px;height:20px}.pair-section-label{margin:27px 0 0;color:#a7abad;font-size:11px;letter-spacing:.09em;font-weight:700;text-transform:uppercase}.pair-actions{margin-top:auto;padding-top:32px}.pair-primary,.pair-secondary{width:100%;min-height:56px;border-radius:14px;font:inherit;font-size:15px;font-weight:700;cursor:pointer}.pair-primary{border:0;background:var(--pair-accent);color:var(--pair-ink)}.pair-primary:disabled{opacity:.45;cursor:default}.pair-secondary{border:1px solid #45474a;color:#f3f3f3;background:#1a1b1d}.pair-text-button{border:0;background:none;color:var(--pair-accent);font:inherit;font-size:14px;font-weight:650;padding:13px 0;cursor:pointer}.pair-network-head{text-align:center;padding:20px 0 6px}.pair-network-head h1{overflow-wrap:anywhere}.pair-field{display:block;margin:32px 0 8px;font-size:13px;font-weight:650;color:#d9dadd}.pair-password-wrap{display:flex;align-items:center;border:1px solid #515359;border-radius:13px;background:#17181a}.pair-password-wrap:focus-within{border-color:var(--pair-accent)}#pair-password{flex:1;min-width:0;border:0;outline:0;background:none;color:#fff;padding:16px;font:inherit;font-size:16px}.pair-password-wrap button{border:0;background:none;color:#d8d9da;font:inherit;font-size:13px;font-weight:650;padding:16px;cursor:pointer}.pair-hint{font-size:13px;line-height:1.5;color:#a7abad;margin:13px 0 0}.pair-note{margin-top:22px;padding:15px 16px;border-radius:13px;border:1px solid #36383b;background:#17181a;color:#bbbfc1;font-size:13px;line-height:1.5}.pair-note strong{color:#f5f5f5}.pair-status{min-height:22px;margin:14px 0 0;font-size:13px;line-height:1.45;color:#bdc0c2}.pair-status.error{color:#ff8e91}.pair-spinner{display:inline-block;width:15px;height:15px;border:2px solid #515254;border-top-color:var(--pair-accent);border-radius:50%;vertical-align:-3px;margin-right:8px;animation:pair-spin .8s linear infinite}@keyframes pair-spin{to{transform:rotate(360deg)}}@media(prefers-reduced-motion:reduce){.pair-spinner{animation:none}}
@media(min-width:650px){#pairing{max-width:500px;height:min(850px,94vh);margin:auto;border:1px solid #33363a;border-radius:24px;box-shadow:0 30px 100px #000}.pair-shell{min-height:100%;padding-top:14px;padding-bottom:26px}}
/* A restrained metallic edge keeps the connection flow in the Magoo palette. */
.pair-mark{position:relative;overflow:hidden}.pair-mark::after{content:'';position:absolute;inset:0;pointer-events:none;background:linear-gradient(120deg,transparent 30%,rgba(255,255,255,.06) 50%,transparent 70%);transform:translateX(-130%)}
#pairing[open] .pair-mark::after{animation:pair-sheen 1s ease-out .15s both}@keyframes pair-sheen{to{transform:translateX(130%)}}@media(prefers-reduced-motion:reduce){#pairing[open] .pair-mark::after{animation:none}}
</style><style>/* Vehicle data and controls use the website's red; display themes stay on the ESP. */
.vehicle-card{padding:18px}.vehicle-heading{display:flex;align-items:flex-start;justify-content:space-between;gap:12px}.vehicle-heading .caption{margin-top:4px}.vehicle-live{border:1px solid #414246;border-radius:999px;padding:4px 9px;color:#bcbfc1;font-size:10px;font-weight:700;white-space:nowrap}.vehicle-live.online{border-color:#713238;color:#f07177;background:#281517}
.vehicle-grid{display:grid;grid-template-columns:repeat(2,minmax(0,1fr));gap:8px;margin-top:16px}.vehicle-stat{min-width:0;border:1px solid #343538;border-radius:12px;background:linear-gradient(145deg,#1b1c1e,#131416);padding:12px 13px}.vehicle-label{display:flex;align-items:center;gap:7px;color:#aeb0b3;font-size:11px;font-weight:650}.vehicle-label svg{width:15px;height:15px;fill:none;stroke:#e95c64;stroke-width:1.8;stroke-linecap:round;stroke-linejoin:round}.vehicle-value{display:block;margin-top:9px;color:#f7f7f7;font-size:21px;line-height:1.1;letter-spacing:-.03em;font-weight:700;font-variant-numeric:tabular-nums;overflow-wrap:anywhere}.vehicle-value.text{font-size:15px;letter-spacing:0;line-height:1.5}.vehicle-note{display:block;margin-top:4px;color:#9a9da0;font-size:11px;line-height:1.3}
#winch-controls .winch-head{display:flex;justify-content:space-between;gap:10px;align-items:center}#winch-controls .winch-hint{font-size:11px;color:#a9abad}#winch-controls .winch-actions{display:flex;gap:12px;margin-top:15px}#winch-controls .winch-button{flex:1;min-height:58px;border:1px solid #e33b45;border-radius:12px;background:linear-gradient(180deg,#d5313b,#a8141d);box-shadow:inset 0 1px 0 rgba(255,255,255,.18),0 4px 0 #700e15,0 8px 18px rgba(0,0,0,.22);color:white;font:inherit;font-weight:750;cursor:pointer;transform:translateY(0);transition:transform .08s ease,box-shadow .08s ease;touch-action:none;user-select:none;-webkit-user-select:none;-webkit-touch-callout:none}#winch-controls .winch-button.active,#winch-controls .winch-button:active{transform:translateY(3px);box-shadow:inset 0 2px 7px rgba(0,0,0,.36),0 1px 0 #700e15}#winch-controls .winch-button:focus-visible{outline:2px solid #fff;outline-offset:4px}#winch-status{min-height:17px;margin-top:6px}#winch-status.active{color:#f2787f}
.vehicle-switch{display:flex;align-items:center;justify-content:space-between;gap:14px;min-height:44px;font-size:12px;color:#e3e3e4;cursor:pointer}.vehicle-switch input{appearance:none;-webkit-appearance:none;position:relative;flex:none;width:43px;height:26px;border-radius:999px;background:#45474a;border:1px solid #5a5b5e;margin:0;cursor:pointer;transition:background .15s}.vehicle-switch input::after{content:'';position:absolute;left:3px;top:3px;width:18px;height:18px;border-radius:50%;background:#eee;box-shadow:0 2px 5px #0006;transition:transform .15s}.vehicle-switch input:checked{background:#b91d29;border-color:#dc3944}.vehicle-switch input:checked::after{transform:translateX(17px)}.vehicle-switch input:focus-visible{outline:2px solid #fff;outline-offset:3px}.feedback-message{min-height:18px;margin-top:8px;color:#adb0b2;font-size:12px}.feedback-message.error{color:#ff999e}
@media(prefers-reduced-motion:reduce){#winch-controls .winch-button,.vehicle-switch input,.vehicle-switch input::after{transition:none}}

/* Compact daily-use layout. The existing Magoo artwork and app icons are retained. */
main{padding-bottom:28px}.hero{height:116px;margin-bottom:10px;padding:19px 20px 12px;background-position:center 57%}.hero .brand{font-size:35px;line-height:1}.hero .subbrand{font-size:9px;letter-spacing:3px;margin-top:4px}.hero .tagline{font-size:8px;letter-spacing:2px;margin-top:9px}
.connection-card{display:flex;align-items:center;gap:10px;padding:12px 14px}.connection-column{align-self:stretch;flex:1;min-width:0}.connection-label{display:block;font-size:9px;letter-spacing:.09em;color:#9da0a3;font-weight:750}.connection-column .connection{margin-top:4px;color:#f0f0f1;font-size:12px;white-space:nowrap}.connection-column .connection.online{color:#f0f0f1}.connection-column .dot{background:#e83a44}.connection-column .online .dot{background:#61df97}.connection-detail{display:block;margin-top:2px;overflow:hidden;text-overflow:ellipsis;white-space:nowrap;font-size:10px;color:#9b9da0}.connection-card .power-button,.settings-icon{flex:none;width:44px;height:44px;border:1px solid #494b4e;border-radius:12px;background:#1d1e20;color:#e4e5e6;display:grid;place-items:center;cursor:pointer}.connection-card .power-button.on{color:#61df97;border-color:#3b865d;background:#14261d}.connection-card .power-button.standby{color:#d6b47f;border-color:#705c3b;background:#252019}.settings-icon svg,.settings-close svg{width:21px;height:21px;fill:none;stroke:currentColor;stroke-width:1.8;stroke-linecap:round;stroke-linejoin:round}.settings-icon:focus-visible,.settings-close:focus-visible{outline:2px solid #fff;outline-offset:3px}
.display-card{padding:14px}.display-heading{display:flex;align-items:center;justify-content:space-between;gap:10px;margin:0 1px 12px}.display-heading .caption{margin-top:2px}.display-badge{font-size:9px;font-weight:750;letter-spacing:.08em;color:#b7b9bb}.display-views-label{font-size:9px;letter-spacing:.1em;font-weight:750;color:#989a9d;margin:14px 1px 10px}.display-card .view-grid{grid-template-columns:repeat(5,minmax(0,1fr));gap:6px;margin:0}.display-card .view-choice{min-width:0;min-height:44px}.display-card .app-icon{width:100%;max-width:70px;margin:0 auto}.display-card .view-choice strong{font-size:clamp(9px,2.35vw,10px);line-height:1.2;white-space:normal;overflow-wrap:normal;margin-top:6px}
#winch-controls{padding:15px}.winch-settings{border-top:1px solid #333538;margin-top:15px}.winch-settings summary{min-height:42px;display:flex;align-items:center;justify-content:space-between;color:#c2c4c6;font-size:12px;font-weight:650;cursor:pointer}.winch-settings[open] summary span{transform:rotate(180deg)}.winch-settings .vehicle-switch{padding-bottom:4px}.context-shortcut{display:flex;align-items:center;justify-content:space-between;gap:16px}.context-shortcut[hidden]{display:none}.context-shortcut .action{flex:none;min-height:44px}.gps-download{display:flex;justify-content:space-between;align-items:center;min-height:44px;color:#f08a90;text-decoration:none;font-size:13px;font-weight:650;margin-top:8px}
.vehicle-grid{grid-template-columns:repeat(3,minmax(0,1fr))}.vehicle-stat{padding:11px 10px}.vehicle-value{font-size:19px}.vehicle-label{font-size:10px}.vehicle-note{font-size:10px}
#settings-dialog{position:fixed;inset:0;width:100%;height:100%;max-width:none;max-height:none;margin:0;padding:0;border:0;background:#0c0d0f;color:#f5f5f5;overflow:auto;font:inherit}#settings-dialog:not([open]){display:none}#settings-dialog::backdrop{background:#000c}.settings-shell{max-width:540px;margin:auto;padding:calc(18px + env(safe-area-inset-top)) 16px calc(28px + env(safe-area-inset-bottom))}.settings-header{display:flex;align-items:center;justify-content:space-between;gap:16px;margin-bottom:18px}.settings-kicker{font-size:9px;font-weight:750;letter-spacing:.16em;color:#a9aaad}.settings-header h1{font-size:27px;letter-spacing:-.03em;margin:5px 0 0}.settings-close{width:44px;height:44px;border:1px solid #44464a;border-radius:12px;background:#202123;color:#f5f5f5;display:grid;place-items:center;cursor:pointer}.settings-section-label{font-size:10px;letter-spacing:.12em;font-weight:750;color:#a0a3a5;margin:24px 3px 9px}#settings-dialog .card{margin:8px 0}#settings-dialog .tiles{gap:8px}
@media(min-width:650px){#settings-dialog{max-width:560px;height:min(850px,94vh);margin:auto;border:1px solid #33363a;border-radius:22px;box-shadow:0 30px 100px #000}.settings-shell{padding:22px}}
.view-label-short{display:none}
@media(max-width:350px){.view-label-full{display:none}.view-label-short{display:inline}}
@media(max-width:340px){.connection-card{gap:4px;padding:10px}.connection-card .power-button,.settings-icon{width:44px;height:44px}.vehicle-stat{padding:10px 7px}.vehicle-value{font-size:17px}}

/* Keep incline calibration compact, while leaving room for feedback when needed. */
#tilt-controls .actions{justify-content:center}#tilt-controls .feedback-message{text-align:center}#tilt-controls .feedback-message:empty{display:none}
</style></head><body><main><header class="hero"><div class="brand">Magoo</div><div class="subbrand">CONTROL CENTER</div><div class="tagline">REMOTE CONTROL ESP32 DASHBOARD</div></header>
<section class="card connection-card" aria-label="Connections"><div class="connection-column"><span class="connection-label">MAGOO</span><div class="connection" id="conn"><span class="dot"></span>Connecting...</div><span class="connection-detail" id="network">Checking connection</span></div><div class="connection-column"><span class="connection-label">RECEIVER</span><div class="connection" id="remote-connection"><span class="dot"></span>Checking...</div><span class="sr" id="remote-detail">Checking receiver signal</span></div><button type="button" id="power-toggle" class="power-button" aria-label="Checking display power" title="Checking display power" disabled><svg viewBox="0 0 24 24" aria-hidden="true"><path d="M12 2v10M6.34 5.64a8 8 0 1 0 11.32 0"/></svg></button><button class="settings-icon" id="settings-open" type="button" aria-label="Open settings"><svg viewBox="0 0 24 24" aria-hidden="true"><path d="M9.09 4.98 L10.15 2.48 L13.85 2.48 L14.91 4.98 L17.42 3.96 L20.04 6.58 L19.02 9.09 L21.52 10.15 L21.52 13.85 L19.02 14.91 L20.04 17.42 L17.42 20.04 L14.91 19.02 L13.85 21.52 L10.15 21.52 L9.09 19.02 L6.58 20.04 L3.96 17.42 L4.98 14.91 L2.48 13.85 L2.48 10.15 L4.98 9.09 L3.96 6.58 L6.58 3.96 Z"/><circle cx="12" cy="12" r="3"/></svg></button></section>
<section class="card display-card" id="display-card"><div class="display-heading"><div><div class="title">Magoo display</div><div class="caption">Tap the screen to interact</div></div><span class="display-badge" id="display-badge">CHECKING</span></div><canvas id="mirror" width="240" height="135" aria-label="Live ESP display. Tap the home screen map or music controls." style="display:block;width:100%;height:auto;aspect-ratio:16/9;background:#08090a;border-radius:8px;margin-top:0;image-rendering:pixelated;touch-action:manipulation"></canvas><div class="caption" id="mirror-status" role="status"></div><div class="display-views-label">DISPLAY VIEWS</div><div class="view-grid"><button type="button" class="view-choice" id="view-home"><span class="app-icon home" aria-hidden="true"></span><strong>Home</strong></button><button type="button" class="view-choice" id="view-speed" aria-label="Speedometer"><span class="app-icon speed" aria-hidden="true"></span><strong><span class="view-label-full">Speedometer</span><span class="view-label-short" aria-hidden="true">Speed</span></strong></button><button type="button" class="view-choice" id="view-nav" aria-label="Navigation"><span class="app-icon nav" aria-hidden="true"></span><strong><span class="view-label-full">Navigation</span><span class="view-label-short" aria-hidden="true">Maps</span></strong></button><button type="button" class="view-choice" id="view-music"><span class="app-icon music" aria-hidden="true"></span><strong>Music</strong></button><button type="button" class="view-choice" id="view-tilt"><span class="app-icon tilt" aria-hidden="true"><svg viewBox="0 0 48 48" style="width:60%;height:60%;fill:none;stroke:#f5f5f5;stroke-width:2.6;stroke-linecap:round;stroke-linejoin:round"><circle cx="24" cy="24" r="18"/><path d="M10 29l28-10M24 8v4M9 24h4m22 0h4M24 36v4"/><circle cx="24" cy="24" r="3" style="fill:#e7353e;stroke:none"/></svg></span><strong>Incline</strong></button></div></section>
<section class="card" id="winch-controls"><div class="winch-head"><div class="title">Winch</div><span class="winch-hint">Hold to move</span></div><div class="caption" id="winch-status" role="status">Ready · release to stop</div><div class="winch-actions"><button class="winch-button" id="winch-out" type="button" aria-label="Hold to let winch out">▲ &nbsp;Out</button><button class="winch-button" id="winch-in" type="button" aria-label="Hold to pull winch in">▼ &nbsp;In</button></div><details class="winch-settings" id="winch-settings"><summary>Winch settings <span aria-hidden="true">⌄</span></summary><label class="vehicle-switch"><span>Reverse winch direction</span><input type="checkbox" id="winch-reverse"></label></details></section><section class="card" id="tilt-controls" hidden><div class="title">Incline</div><div class="caption" id="tilt-status">Checking sensor...</div><div class="actions"><button class="action" id="tilt-zero" type="button">Set level</button></div><div class="feedback-message" id="tilt-message" role="status"></div></section>
<section class="card context-shortcut" id="gear-shortcut-card" hidden><div><div class="title">Speedometer</div><div class="caption">Simulated gears and RPM are based on throttle.</div></div><button class="action" id="gear-shortcut" type="button">Calibrate</button></section><section class="card context-shortcut" id="home-shortcut-card" hidden><div><div class="title">Home screen</div><div class="caption">Change the map and music layout.</div></div><button class="action" id="home-shortcut" type="button">Customize</button></section>
<section class="card" id="music-controls" hidden><div class="row"><img id="album-art" src="/album/0.jpg" width="76" height="76" alt="Album cover" style="border-radius:9px;object-fit:cover"><div class="meta"><div class="title" id="track">Music demo</div><div class="caption" id="artist">Artist</div><div class="caption">Simulated player · no audio</div></div></div><div class="caption" id="track-time" style="margin-top:12px">0:00 / 0:00</div><div class="actions"><button class="action" id="previous" type="button">Previous</button><button class="action primary" id="play" type="button">Pause</button><button class="action" id="next" type="button">Next</button><button class="action" id="shuffle" type="button" aria-pressed="false">Shuffle off</button></div><label class="field" for="playlist">Choose a song</label><select id="playlist"><option value="">Loading songs...</option></select></section>
<section class="card" id="gps-controls" hidden><div class="row"><svg class="glyph" style="color:#f13c46" viewBox="0 0 24 24"><path d="M20 10c0 5-8 11-8 11S4 15 4 10a8 8 0 1 1 16 0z"/><circle cx="12" cy="10" r="2.5"/></svg><div class="meta"><div class="title">Phone GPS</div><div class="caption" id="gps-status">Waiting for the companion app</div></div></div><div class="gps-panel" id="gps-panel">Open the Magoo GPS app to send your phone’s location to the display.</div><div class="caption">Map data © OpenStreetMap contributors when available.</div><a class="gps-download" href="/app.apk">Get the Android GPS app <span aria-hidden="true">›</span></a></section>
<section class="card vehicle-card" id="vehicle-status" aria-labelledby="vehicle-title"><div class="vehicle-heading"><div><div class="title" id="vehicle-title">Vehicle status</div><div class="caption">A quick look at your crawler</div></div><span class="vehicle-live" id="vehicle-live">Checking</span></div><div class="vehicle-grid"><div class="vehicle-stat"><div class="vehicle-label"><svg viewBox="0 0 24 24" aria-hidden="true"><rect x="2" y="6" width="18" height="12" rx="2"/><path d="M22 10v4M7 10v4m4-4v4"/></svg>Battery</div><strong class="vehicle-value" id="vehicle-battery">—</strong><span class="vehicle-note" id="vehicle-battery-note">Checking sensor</span></div><div class="vehicle-stat"><div class="vehicle-label"><svg viewBox="0 0 24 24" aria-hidden="true"><path d="M4 19h16M5 17 17 6M15 6h2v2"/></svg>Pitch</div><strong class="vehicle-value" id="vehicle-pitch">—</strong><span class="vehicle-note" id="vehicle-pitch-note">Checking sensor</span></div><div class="vehicle-stat"><div class="vehicle-label"><svg viewBox="0 0 24 24" aria-hidden="true"><path d="M4 18h16M5 15l14-5M17 8l2 2-1 2"/></svg>Roll</div><strong class="vehicle-value" id="vehicle-roll">—</strong><span class="vehicle-note" id="vehicle-roll-note">Checking sensor</span></div></div></section>
<div class="footer" id="status" role="status"></div></main><dialog id="settings-dialog" aria-labelledby="settings-title"><div class="settings-shell"><header class="settings-header"><div><span class="settings-kicker">MAGOO CONTROL CENTER</span><h1 id="settings-title">Settings</h1></div><button type="button" class="settings-close" id="settings-close" aria-label="Close settings"><svg viewBox="0 0 24 24" aria-hidden="true"><path d="M5 5l14 14M19 5 5 19"/></svg></button></header><p class="settings-section-label">DISPLAY</p><section class="card"><div class="row"><svg class="glyph" viewBox="0 0 24 24"><rect x="2" y="3" width="20" height="15" rx="1"/><path d="M8 22h8m-4-4v4"/></svg><div class="meta"><div class="title">Display Theme</div><div class="caption">Choose a look for the Magoo display</div></div></div><div class="themes" id="themes"></div></section><section class="card" id="home-controls"><div class="title">Home Screen layout</div><div class="caption">Choose what Home displays</div><label class="sr" for="home-layout">Home Screen layout</label><select id="home-layout" style="margin-top:12px"><option value="0">Map and music</option><option value="1">Map focus</option><option value="2">Music focus</option></select><label class="field" for="home-style">Offline home map style</label><select id="home-style"><option value="0">Day</option><option value="1">Night</option></select><label class="vehicle-switch" style="margin-top:14px"><span>Startup animation</span><input id="boot-animation" type="checkbox"></label><div class="caption">Startup changes apply after restarting the ESP32.</div></section><p class="settings-section-label">CALIBRATION</p><details class="card" id="settings-tilt-controls"><summary class="row"><div class="meta"><div class="title">Incline calibration</div><div class="caption">Set the crawler’s level position</div></div><span class="chev">›</span></summary><div class="setup"><p class="note">Park the crawler level and still. Mount the sensor securely with Y front to back and X side to side.</p><button class="action" id="settings-tilt-zero" type="button" disabled>Set level</button><div class="feedback-message" id="settings-tilt-message" role="status"></div></div></details><details class="card" id="gear-controls"><summary class="row"><svg class="glyph" viewBox="0 0 24 24" aria-hidden="true"><path d="M5 4v7a3 3 0 0 0 3 3h8a3 3 0 0 0 3-3V4M5 14v6m14-6v6M12 4v16"/><circle cx="5" cy="4" r="1.5"/><circle cx="12" cy="4" r="1.5"/><circle cx="19" cy="4" r="1.5"/></svg><div class="meta"><div class="title">Gear indicator</div><div class="caption" id="gear-status">Checking receiver...</div></div><span class="chev">›</span></summary><div class="setup"><p class="note">Keep the crawler’s wheels clear. With the throttle released, tap Set neutral. Then hold forward and tap Set forward.</p><div class="actions"><button class="action" type="button" id="gear-neutral">Set neutral</button><button class="action" type="button" id="gear-forward">Set forward</button></div><p class="note" id="gear-message" role="status">Gears 1–5 and RPM are simulated from throttle. Reverse is a command and may initially brake on some controllers.</p></div></details><p class="settings-section-label">CONNECTION &amp; SETUP</p><div class="tiles"><button class="card tile button" id="wifi-open" type="button" style="width:100%;text-align:left;color:inherit;cursor:pointer"><div class="row"><svg class="glyph" viewBox="0 0 24 24" aria-hidden="true"><path d="M2 9a15 15 0 0 1 20 0M5 12a10 10 0 0 1 14 0M8 15a6 6 0 0 1 8 0"/><circle cx="12" cy="19" r="1"/></svg><div class="meta"><div class="title">Connect Magoo</div><div class="caption">Set up Wi-Fi or a phone hotspot</div></div><span class="chev">›</span></div></button><a class="card tile button" href="/app.apk"><div class="row"><svg class="glyph" viewBox="0 0 24 24"><path d="M7 9a5 5 0 0 1 10 0v7H7zM8 4 6 2m10 2 2-2M4 10v5m16-5v5M9 16v5m6-5v5"/></svg><div class="meta"><div class="title">Android App</div><div class="caption">Download companion app</div></div><span class="chev">›</span></div></a></div></div></dialog><dialog id="pairing" aria-labelledby="pair-header"><div class="pair-shell">
<header class="pair-top"><button class="pair-icon-button" id="pair-back" type="button" aria-label="Go back"><svg viewBox="0 0 24 24"><path d="m15 5-7 7 7 7"/></svg></button><strong id="pair-header">Connect Magoo</strong><button class="pair-icon-button" id="pair-close" type="button" aria-label="Close setup"><svg viewBox="0 0 24 24"><path d="M5 5l14 14M19 5 5 19"/></svg></button></header>
<section class="pair-screen" data-pair-screen="welcome"><div class="pair-intro"><div class="pair-mark"><svg viewBox="0 0 24 24" aria-hidden="true"><rect x="3" y="11" width="18" height="10" rx="2"/><path d="M7 11V9a5 5 0 0 1 10 0v2M8 16h.01M12 16h4"/></svg></div><h1 tabindex="-1">Get Magoo connected</h1><p class="pair-lead">Choose how you want to connect. Magoo remembers both for next time.</p></div><div class="pair-list"><button class="pair-choice" id="pair-mode-0" type="button" aria-pressed="true"><span class="pair-icon"><svg viewBox="0 0 24 24"><path d="M3 10.5 12 3l9 7.5M5 9.5V21h5v-6h4v6h5V9.5"/></svg></span><span class="pair-copy"><strong>Home Wi-Fi</strong><small id="pair-mode-note-0">For use around home</small></span><span class="pair-chevron">›</span></button><button class="pair-choice" id="pair-mode-1" type="button" aria-pressed="false"><span class="pair-icon"><svg viewBox="0 0 24 24"><rect x="6" y="2" width="12" height="20" rx="2"/><path d="M10 19h4"/></svg></span><span class="pair-copy"><strong>Phone hotspot</strong><small id="pair-mode-note-1">For use away from home</small></span><span class="pair-chevron">›</span></button></div><p id="pair-welcome-status" class="pair-status" role="status"></p><div class="pair-actions"><button id="pair-continue" class="pair-primary" type="button">Continue</button></div></section>
<section class="pair-screen" data-pair-screen="setup" hidden><div class="pair-intro"><div class="pair-mark"><svg viewBox="0 0 24 24"><path d="M2 9a15 15 0 0 1 20 0M5 12a10 10 0 0 1 14 0M8 15a6 6 0 0 1 8 0"/><circle cx="12" cy="19" r="1"/></svg></div><h1 tabindex="-1">Connect your phone to Magoo</h1><p class="pair-lead">A direct connection lets you change Magoo’s Wi-Fi settings.</p></div><div class="pair-note"><strong>1.</strong> Open your phone’s Wi-Fi settings.<br><br><strong>2.</strong> Join <strong>MagooESP</strong> using your Magoo setup password.<br><br><strong>3.</strong> Return here and tap the button below.</div><p class="pair-hint">Your phone may say this network has no internet. Stay connected to finish setup.</p><div class="pair-actions"><button id="pair-open-setup" class="pair-primary" type="button">Open Magoo setup</button></div></section>
<section class="pair-screen" data-pair-screen="networks" hidden><div><h1 tabindex="-1">Choose a network</h1><p class="pair-lead" id="pair-network-subtitle">Select the network Magoo should use.</p><p class="pair-status" id="pair-scan-status" role="status">Looking for networks…</p><div class="pair-list" id="pair-networks-list" style="margin-top:14px"></div><button id="pair-scan" class="pair-text-button" type="button">↻ &nbsp;Search again</button><p class="pair-hint" id="pair-network-hint">Magoo supports 2.4 GHz Wi-Fi.</p></div></section>
<section class="pair-screen" data-pair-screen="password" hidden><div class="pair-network-head"><div class="pair-mark"><svg viewBox="0 0 24 24"><path d="M2 9a15 15 0 0 1 20 0M5 12a10 10 0 0 1 14 0M8 15a6 6 0 0 1 8 0"/><circle cx="12" cy="19" r="1"/></svg></div><h1 id="pair-selected-name" tabindex="-1"></h1><p class="pair-lead" id="pair-selected-detail"></p></div><form id="pair-form" style="display:flex;flex:1;flex-direction:column"><div id="pair-password-area"><label class="pair-field" for="pair-password">Wi-Fi password</label><div class="pair-password-wrap"><input id="pair-password" type="password" autocomplete="current-password" maxlength="63" placeholder="Enter password"><button id="pair-show-password" type="button" aria-label="Show password">Show</button></div><p class="pair-hint">Magoo saves the password after it connects so it can reconnect later.</p></div><div id="pair-saved-note" class="pair-note" hidden>Magoo will use the password saved for this network.</div><button id="pair-change-password" class="pair-text-button" type="button" hidden>Use a different password</button><p class="pair-status error" id="pair-form-error" role="alert"></p><div class="pair-actions"><button class="pair-primary" type="submit">Connect Magoo</button></div></form></section>
<section class="pair-screen" data-pair-screen="connecting" hidden><div class="pair-intro"><div class="pair-mark"><span class="pair-spinner" aria-hidden="true"></span></div><h1 tabindex="-1">Connecting Magoo</h1><p class="pair-lead">Joining <strong id="pair-connecting-name"></strong>. This can take a little while.</p></div><div class="pair-note">Your phone may briefly disconnect from MagooESP while the connection changes.</div></section>
<section class="pair-screen" data-pair-screen="success" hidden><div class="pair-intro"><div class="pair-mark good"><svg viewBox="0 0 24 24"><path d="m5 12 5 5 9-10"/></svg></div><h1 tabindex="-1">You’re connected</h1><p class="pair-lead">Magoo joined <strong id="pair-success-name"></strong> and will remember it for next time.</p></div><div class="pair-note">To use the dashboard on this network, connect your phone to the same Wi-Fi and open <strong>magooesp.local</strong>.</div><div class="pair-actions"><button id="pair-done" class="pair-primary" type="button">Done</button></div></section>
<section class="pair-screen" data-pair-screen="failed" hidden><div class="pair-intro"><div class="pair-mark"><svg viewBox="0 0 24 24"><path d="M12 4v9m0 4h.01"/><circle cx="12" cy="12" r="9"/></svg></div><h1 tabindex="-1">Let’s try that again</h1><p class="pair-lead" id="pair-failure-message"></p></div><div class="pair-actions"><button id="pair-try-again" class="pair-primary" type="button">Back to setup</button></div></section>
</div></dialog><script>/* Exact, per-client cache of the ESP's RGB565 screen. */
(function (root, factory) {
  const api=factory();
  if (typeof module==='object' && module.exports) module.exports=api;
  if (root) root.MagooFrames=api;
})(typeof window==='undefined' ? null : window, function () {
  const WIDTH=240, HEIGHT=135, TILE_WIDTH=16, TILE_HEIGHT=15, COLS=15, COUNT=135;
  const FRAME_BYTES=WIDTH*HEIGHT*2, TILE_BYTES=1+TILE_WIDTH*TILE_HEIGHT*2;
  const bytes=value=>value instanceof Uint8Array ? value : new Uint8Array(value);
  class FrameCache {
    constructor() { this.clear(); }
    clear() { this.pixels=null;this.hashes=new Uint32Array(COUNT);this.updates=0; }
    get ready() { return this.pixels!==null; }
    get needsFull() { return !this.ready || this.updates>=120; }
    hash(tile) {
      const x=(tile%COLS)*TILE_WIDTH, y=Math.floor(tile/COLS)*TILE_HEIGHT;
      let h=2166136261;
      for(let row=0;row<TILE_HEIGHT;row++) {
        let pos=((y+row)*WIDTH+x)*2;
        for(let i=0;i<TILE_WIDTH*2;i++) h=Math.imul(h^this.pixels[pos++],16777619)>>>0;
      }
      return h>>>0;
    }
    setFull(value) {
      const data=bytes(value);
      if(data.length!==FRAME_BYTES) throw new Error('Invalid full frame');
      this.pixels=data.slice();
      for(let i=0;i<COUNT;i++) this.hashes[i]=this.hash(i);
      this.updates=0;
    }
    hashText() {
      if(!this.ready) throw new Error('No cached frame');
      return Array.from(this.hashes,h=>h.toString(16).padStart(8,'0')).join('');
    }
    apply(value) {
      const data=bytes(value);
      if(!this.ready || data.length<4 || data[0]!==77 || data[1]!==68 || data[3]!==49) throw new Error('Invalid frame update');
      if(data[2]===70) {
        if(data.length!==FRAME_BYTES+4) throw new Error('Invalid replacement frame');
        this.setFull(data.subarray(4));return true;
      }
      if(data[2]!==76 || data.length<6 || data[5]!==0 || data[4]>COUNT || data.length!==6+data[4]*TILE_BYTES)
        throw new Error('Invalid frame patches');
      const count=data[4],seen=new Uint8Array(COUNT);
      for(let i=0;i<count;i++) {
        const tile=data[6+i*TILE_BYTES];
        if(tile>=COUNT || seen[tile]) throw new Error('Invalid frame tile');
        seen[tile]=1;
      }
      for(let i=0;i<count;i++) {
        let pos=6+i*TILE_BYTES;
        const tile=data[pos++], x=(tile%COLS)*TILE_WIDTH,y=Math.floor(tile/COLS)*TILE_HEIGHT;
        for(let row=0;row<TILE_HEIGHT;row++) {
          const dest=((y+row)*WIDTH+x)*2;
          this.pixels.set(data.subarray(pos,pos+TILE_WIDTH*2),dest);pos+=TILE_WIDTH*2;
        }
        this.hashes[tile]=this.hash(tile);
      }
      this.updates++;
      return count>0;
    }
  }
  return { FrameCache };
});
</script><script>(function (root) {
  async function installMusic({ request, loadPackage, progress = () => {} }) {
    const status = await request('/modules/music');
    if (status.status === 404 || status.status === 405) return; // Older firmware already includes Music.
    if (!status.ok) throw new Error('Could not check Music on Magoo');
    const state = await status.json();
    const raw = atob(await loadPackage());
    if (raw.length < 16 || raw.slice(0, 4) !== 'MGMP') throw new Error('Music package is invalid');
    const checksum = (raw.charCodeAt(12) | raw.charCodeAt(13) << 8 | raw.charCodeAt(14) << 16 | raw.charCodeAt(15) << 24) >>> 0;
    if (state.installed && state.version === 1 && state.checksum === checksum) return;
    if (state.version !== 1) throw new Error('This Music package requires a compatible Magoo update');
    if (state.installing) throw new Error('Another Music installation is in progress');
    const send = async (path, data) => {
      const response = await request(path, data);
      if (!response.ok) throw new Error((await response.text()) || 'Music installation failed');
      return response;
    };
    progress('Preparing Music…');
    const start = await send('/modules/music/start', { size: raw.length });
    const { token } = await start.json();
    if (!Number.isSafeInteger(token) || token <= 0) throw new Error('Invalid installation response');
    for (let offset = 0; offset < raw.length; offset += 1024) {
      let hex = '';
      for (let i = offset; i < Math.min(offset + 1024, raw.length); i++) hex += raw.charCodeAt(i).toString(16).padStart(2, '0');
      await send('/modules/music/chunk', { token, offset, data: hex });
      progress('Installing Music… ' + Math.round(100 * Math.min(offset + 1024, raw.length) / raw.length) + '%');
    }
    await send('/modules/music/finish', { token });
    progress('Music installed');
  }
  if (typeof module !== 'undefined' && module.exports) module.exports = { installMusic };
  else root.magooInstallMusic = installMusic;
})(typeof window !== 'undefined' ? window : globalThis);
</script><script>
const nativeApp=new URLSearchParams(location.search).get('app')==='1';const $=id=>document.getElementById(id),themes=$('themes');const musicHint=document.createElement('p');musicHint.id='music-install-status';musicHint.className='caption';musicHint.setAttribute('role','status');musicHint.hidden=true;document.querySelector('#view-music').parentElement.insertAdjacentElement('afterend',musicHint);let currentTheme=0,currentView='speedometer',currentLayout=0;const names=['Jeep red','Electric blue','Desert amber','Trail green'];const colors=['#ef3038','#36bef0','#e9a23b','#54ca81'];
function makeThemes(){themes.replaceChildren();names.forEach((name,i)=>{const b=document.createElement('button');b.type='button';b.className='theme'+(i===currentTheme?' selected':'');b.setAttribute('aria-label',name);b.setAttribute('aria-pressed',String(i===currentTheme));b.innerHTML='<span class="preview" style="--accent:'+colors[i]+'"><strong>00</strong><small>KM/H</small></span><span class="label">'+name+'</span>';b.onclick=async()=>{if(await post('/theme',{value:i})){currentTheme=i;makeThemes()}};themes.append(b)})}makeThemes();
function updateViews(){$('gear-shortcut-card').hidden=currentView!=='speedometer';$('home-shortcut-card').hidden=currentView!=='home';$('tilt-controls').hidden=currentView!=='tilt';$('gps-controls').hidden=currentView!=='navigation';$('music-controls').hidden=currentView!=='music'&&!(currentView==='home'&&currentLayout===2);for(const [id,selected] of [['view-home',currentView==='home'],['view-speed',currentView==='speedometer'],['view-nav',currentView==='navigation'],['view-music',currentView==='music'],['view-tilt',currentView==='tilt']]){const button=$(id);button.classList.toggle('selected',selected);button.setAttribute('aria-pressed',String(selected))}if(typeof window.__magooGpsViewChanged==='function')window.__magooGpsViewChanged()}
let musicInstallActive=false;
async function loadMusicPackage(){
 if(window.__magooMusicPack)return window.__magooMusicPack;
 await new Promise((resolve,reject)=>{const s=document.createElement('script');s.src='/music-pack.js';s.onload=resolve;s.onerror=()=>{s.remove();reject(new Error('Music package is unavailable in this app'))};document.head.appendChild(s)});
 if(!window.__magooMusicPack)throw new Error('Music package is unavailable in this app');return window.__magooMusicPack;
}
async function chooseView(view){
 if(view==='music'&&nativeApp){
  if(musicInstallActive)return;musicInstallActive=true;
  const message=$('music-install-status');message.hidden=false;
  try{releaseWinch();await window.magooInstallMusic({loadPackage:loadMusicPackage,progress:text=>message.textContent=text,
   request:(path,data)=>fetchTimed(path,data?{method:'POST',headers:{'Content-Type':'application/x-www-form-urlencoded'},body:new URLSearchParams(data)}:{},path.endsWith('/start')?30000:6000)});
   message.textContent='Music is ready';
  }catch(e){message.textContent=e.message||'Could not install Music';musicInstallActive=false;return}
  musicInstallActive=false;
 }
 if(await post('/view',{value:view})){currentView=view;updateViews()}
}
$('view-home').onclick=()=>chooseView('home');$('view-speed').onclick=()=>chooseView('speedometer');$('view-nav').onclick=()=>chooseView('navigation');$('view-music').onclick=()=>chooseView('music');$('view-tilt').onclick=()=>chooseView('tilt');$('tilt-zero').onclick=()=>calibrateTilt('tilt-zero','tilt-message');$('settings-tilt-zero').onclick=()=>calibrateTilt('settings-tilt-zero','settings-tilt-message');updateViews();
async function fetchTimed(path,options={},timeout=6000){const controller=new AbortController(),timer=setTimeout(()=>controller.abort(),timeout);try{return await fetch(path,{...options,signal:controller.signal})}finally{clearTimeout(timer)}}
let winchDesired='stop',winchBusy=false,winchPointer=null;
async function pumpWinch(){if(winchBusy)return;winchBusy=true;try{for(;;){const command=winchDesired;const r=await fetchTimed('/winch',{method:'POST',headers:{'Content-Type':'application/x-www-form-urlencoded'},body:new URLSearchParams({direction:command})},1500);if(!r.ok)throw Error();if(command!==winchDesired)continue;if(command==='stop')break;await new Promise(resolve=>setTimeout(resolve,200));}}catch(e){winchDesired='stop';$('winch-status').textContent='Connection lost · release controls';$('winch-status').classList.remove('active');$('winch-out').classList.remove('active');$('winch-in').classList.remove('active');winchPointer=null;}finally{winchBusy=false;}}
function releaseWinch(){if(winchDesired==='stop')return;winchDesired='stop';winchPointer=null;$('winch-out').classList.remove('active');$('winch-in').classList.remove('active');$('winch-status').classList.remove('active');$('winch-status').textContent='Ready · release to stop';pumpWinch();}
for(const [id,direction] of [['winch-out','out'],['winch-in','in']]){const b=$(id);b.addEventListener('contextmenu',e=>e.preventDefault());b.addEventListener('selectstart',e=>e.preventDefault());b.addEventListener('pointerdown',e=>{e.preventDefault();if(winchPointer!==null)return;winchPointer=e.pointerId;winchDesired=direction;b.classList.add('active');$('winch-status').classList.add('active');$('winch-status').textContent=direction==='out'?'Out command':'In command';b.setPointerCapture(e.pointerId);pumpWinch()});b.addEventListener('pointerup',e=>{if(e.pointerId===winchPointer)releaseWinch()});b.addEventListener('pointercancel',e=>{if(e.pointerId===winchPointer)releaseWinch()});b.addEventListener('lostpointercapture',e=>{if(e.pointerId===winchPointer)releaseWinch()});}
window.addEventListener('blur',releaseWinch);document.addEventListener('visibilitychange',()=>{if(document.hidden)releaseWinch()});
function openSettings(section){releaseWinch();const dialog=$('settings-dialog');if(!dialog.open)dialog.showModal();if(section){const element=$(section);if(element.tagName==='DETAILS')element.open=true;requestAnimationFrame(()=>element.scrollIntoView({block:'start',behavior:matchMedia('(prefers-reduced-motion: reduce)').matches?'auto':'smooth'}))}}
$('settings-open').onclick=()=>openSettings();$('settings-close').onclick=()=>$('settings-dialog').close();$('gear-shortcut').onclick=()=>openSettings('gear-controls');$('home-shortcut').onclick=()=>openSettings('home-controls');$('winch-settings').addEventListener('toggle',()=>{if($('winch-settings').open)releaseWinch()});
if(nativeApp){const gps=document.querySelector('#gps-controls a[href=\"/app.apk\"]');if(gps)gps.textContent='Open phone GPS controls ›';const app=document.querySelector('#settings-dialog a[href=\"/app.apk\"]');if(app){app.querySelector('.title').textContent='Phone GPS';app.querySelector('.caption').textContent='Share this phone’s location';}const address=document.createElement('a');address.className='card tile button';address.href='magoo://address';address.innerHTML='<div class=\"row\"><svg class=\"glyph\" viewBox=\"0 0 24 24\" aria-hidden=\"true\"><rect x=\"3\" y=\"4\" width=\"18\" height=\"16\" rx=\"2\"/><path d=\"M3 9h18M7 6.5h.01M10 6.5h.01\"/></svg><div class=\"meta\"><div class=\"title\">Magoo address</div><div class=\"caption\">Connect on Wi-Fi or Magoo’s network</div></div><span class=\"chev\">›</span></div>';app.parentElement.append(address)}

$('winch-reverse').onchange=async()=>{releaseWinch();const r=await post('/winch/reverse',{reversed:$('winch-reverse').checked?1:0});if(!r)$('winch-reverse').checked=!$('winch-reverse').checked};
fetchTimed('/winch/status').then(r=>r.json()).then(d=>{$('winch-reverse').checked=d.reversed;if(!d.ready)$('winch-status').textContent='Winch signal unavailable'}).catch(()=>{$('winch-status').textContent='Winch connection unavailable'});
async function post(path,data){try{const r=await fetch(path,{method:'POST',headers:{'Content-Type':'application/x-www-form-urlencoded'},body:new URLSearchParams(data)});if(!r.ok)throw Error();$('status').textContent='Dashboard updated';return true}catch(e){$('status').textContent='Request failed. Check your connection to MagooESP.';return false}}
async function feedbackButton(button,action,onSuccess){if(button.disabled)return;const original=button.dataset.label||button.textContent;button.dataset.label=original;button.dataset.feedbackBusy='1';button.disabled=true;button.textContent='Saving…';try{const response=await action(),body=await response.text();if(!response.ok)throw Error(body||'Could not save. Try again.');button.textContent=onSuccess;await update()}catch(error){button.textContent='Try again';throw error}finally{setTimeout(()=>{button.textContent=original;button.dataset.feedbackBusy='0';button.disabled=['tilt-zero','settings-tilt-zero'].includes(button.id)&&!lastTiltAvailable},1600)}}
let tiltCalibrationBusy=false;async function calibrateTilt(buttonId,messageId){const button=$(buttonId),message=$(messageId);if(tiltCalibrationBusy||button.disabled)return;tiltCalibrationBusy=true;message.textContent='';message.classList.remove('error');try{await feedbackButton(button,()=>fetchTimed('/tilt/zero',{method:'POST'}),'Level saved');message.textContent='Level saved.'}catch(error){message.classList.add('error');message.textContent=error.message==='Failed to fetch'?'Connection lost. Reconnect and try again.':error.message}finally{tiltCalibrationBusy=false}}
async function calibrateGear(step){const button=$(step==='neutral'?'gear-neutral':'gear-forward'),message=$('gear-message');try{await feedbackButton(button,()=>fetchTimed('/gear/calibrate',{method:'POST',headers:{'Content-Type':'application/x-www-form-urlencoded'},body:new URLSearchParams({step})}),step==='neutral'?'Captured':'Saved');message.textContent=step==='neutral'?'Neutral captured. Hold forward and tap Set forward.':'Calibration saved.'}catch(error){message.textContent=error.message==='Failed to fetch'?'Connection lost. Reconnect and try again.':error.message}}
$('gear-neutral').onclick=()=>calibrateGear('neutral');$('gear-forward').onclick=()=>calibrateGear('forward');
const mirror=$('mirror'),ctx=mirror.getContext('2d'),mirrorStatus=$('mirror-status'),mirrorCache=new MagooFrames.FrameCache();let mirrorBusy=false,mirrorEpoch=0,sleepPending=false,sleeping=false,mirrorVisible=true,updateBusy=false,deltaSupported=true,mirrorFailures=0,mirrorFastTimer=0,mirrorActiveUntil=0,appForeground=true;
async function refreshMirror(){
 if(mirrorBusy||document.hidden||!appForeground||!mirrorVisible||sleeping)return;
 const delta=deltaSupported&&!mirrorCache.needsFull;
 if(winchDesired!=='stop'&&!delta)return;
 mirrorBusy=true;const epoch=mirrorEpoch;
 try{
  const options=delta?{method:'POST',headers:{'Content-Type':'application/x-www-form-urlencoded'},body:new URLSearchParams({hashes:mirrorCache.hashText()})}:{cache:'no-store'};
  const response=await fetchTimed(delta?'/screen-delta':'/screen',options);
  if(epoch!==mirrorEpoch)return;
  if(delta&&(response.status===404||response.status===405)){deltaSupported=false;mirrorCache.clear();setTimeout(refreshMirror,0);return}
  if(response.status===204){mirrorCache.clear();ctx.clearRect(0,0,240,135);const asleep=response.headers.get('X-Display-State')==='sleep';$('display-badge').textContent=asleep?'ASLEEP':'STARTING';mirrorStatus.textContent=asleep?'Display asleep':'Startup playing on ESP';return}
  if(!response.ok)throw Error('Display request failed');
  const data=await response.arrayBuffer();if(epoch!==mirrorEpoch)return;
  let changed=true;
  try{if(delta)changed=mirrorCache.apply(data);else mirrorCache.setFull(data)}catch(error){mirrorCache.clear();setTimeout(refreshMirror,0);throw error}
  if(changed){const pixels=new Uint16Array(mirrorCache.pixels.buffer),img=ctx.createImageData(240,135);for(let i=0;i<pixels.length;i++){const v=pixels[i],j=i*4;img.data[j]=((v>>11)&31)*255/31;img.data[j+1]=((v>>5)&63)*255/63;img.data[j+2]=(v&31)*255/31;img.data[j+3]=255}ctx.putImageData(img,0,0)}
  if(delta&&changed)mirrorActiveUntil=Date.now()+2200;
  if(deltaSupported&&Date.now()<mirrorActiveUntil&&!mirrorFastTimer)mirrorFastTimer=setTimeout(()=>{mirrorFastTimer=0;if(Date.now()<mirrorActiveUntil)refreshMirror()},600);
  mirrorFailures=0;$('display-badge').textContent='LIVE';mirrorStatus.textContent='';
 }catch(e){if(++mirrorFailures>=3||!mirrorCache.ready){$('display-badge').textContent='OFFLINE';mirrorStatus.textContent='Display mirror unavailable. Check the connection.'}}finally{mirrorBusy=false}
}
window.__magooSetAppActive=value=>{if(!nativeApp)return;const active=!!value;if(active===appForeground)return;appForeground=active;if(!active){mirrorEpoch++;if(mirrorFastTimer){clearTimeout(mirrorFastTimer);mirrorFastTimer=0}}else{update();refreshMirror()}};
mirror.addEventListener('click',async e=>{if(sleeping)return;const r=mirror.getBoundingClientRect(),x=Math.min(239,Math.max(0,Math.floor((e.clientX-r.left)*240/r.width))),y=Math.min(134,Math.max(0,Math.floor((e.clientY-r.top)*135/r.height)));try{const response=await fetch('/touch',{method:'POST',headers:{'Content-Type':'application/x-www-form-urlencoded'},body:new URLSearchParams({x,y})});if(!response.ok)throw Error();const data=await response.json();if(data.action==='settings'){openPairing();}else if(data.action==='unavailable')mirrorStatus.textContent='Phone app is a visual placeholder.';else if(data.action==='none')mirrorStatus.textContent='No touch control in this area.';await update();setTimeout(refreshMirror,200)}catch(e){mirrorStatus.textContent='Touch command failed.'}});
function setPowerState(isSleeping){const previous=sleeping;sleeping=!!isSleeping;if(previous!==sleeping){mirrorEpoch++;mirrorCache.clear();if(typeof window.__magooGpsViewChanged==='function')window.__magooGpsViewChanged()}if(sleeping){ctx.clearRect(0,0,240,135);$('display-badge').textContent='ASLEEP';mirrorStatus.textContent='Display asleep'}const button=$('power-toggle');button.classList.toggle('on',!sleeping);button.classList.toggle('standby',sleeping);button.setAttribute('aria-pressed',String(!sleeping));button.setAttribute('aria-label',sleeping?'Display on standby. Tap to wake':'Display on. Tap for standby');button.title=sleeping?'Standby · tap to wake':'On · tap for standby'}
$('power-toggle').onclick=async()=>{if(sleepPending)return;const button=$('power-toggle'),target=!sleeping;sleepPending=true;button.disabled=true;mirrorEpoch++;mirrorCache.clear();ctx.clearRect(0,0,240,135);if(await post('/sleep',{sleep:target?1:0})){setPowerState(target);mirrorStatus.textContent=target?'Display asleep':''}setTimeout(refreshMirror,300);sleepPending=false;await update()};
if('IntersectionObserver' in window){new IntersectionObserver(entries=>{mirrorVisible=entries[0].isIntersecting;if(mirrorVisible)refreshMirror()}).observe(mirror)}refreshMirror();setInterval(refreshMirror,1500);document.addEventListener('visibilitychange',()=>{if(!document.hidden){update();refreshMirror()}});
let lastNetworkIp='';
$('home-style').onchange=async()=>{if(!await post('/appearance',{style:$('home-style').value}))update()};$('boot-animation').onchange=async()=>{if(!await post('/startup',{animated:$('boot-animation').checked?1:0}))update()};
$('home-layout').onchange=async()=>{if(await post('/layout',{value:$('home-layout').value})){currentLayout=Number($('home-layout').value);updateViews();setTimeout(refreshMirror,200)}else update()};
for(const [id,action] of [['previous','previous'],['play','toggle'],['next','next']])$(id).onclick=async()=>{if(await post('/music',{action}))update()};
$('shuffle').onclick=async()=>{if(await post('/music',{action:'shuffle'}))update()};$('playlist').onchange=async()=>{if($('playlist').value!==''&&await post('/music',{action:'select',track:$('playlist').value}))update()};async function loadPlaylist(){try{const tracks=await (await fetch('/playlist')).json();$('playlist').replaceChildren(...tracks.map((track,i)=>new Option(track.artist+' — '+track.title,i)))}catch(e){$('playlist').replaceChildren(new Option('Playlist unavailable',''))}}loadPlaylist();
let lastTiltAvailable=false;
function updateVehicle(d){lastTiltAvailable=!!d&&!!d.tiltValid;const live=$('vehicle-live'),angle=value=>{const n=Number(value);return(n<0?'−':'')+Math.abs(n).toFixed(1)+'°'};live.textContent=d?'Live':'Disconnected';live.classList.toggle('online',!!d);const tilt=!!d&&d.tiltValid&&Number.isFinite(Number(d.pitch))&&Number.isFinite(Number(d.roll));for(const key of ['pitch','roll']){$('vehicle-'+key).textContent=tilt?angle(d[key]):'—';$('vehicle-'+key+'-note').textContent=tilt?'Incline sensor':'Not available'}const battery=!!d&&d.batteryValid&&d.batteryVoltage!==null&&Number.isFinite(Number(d.batteryVoltage));$('vehicle-battery').textContent=battery?Number(d.batteryVoltage).toFixed(1)+' V':'—';$('vehicle-battery-note').textContent=battery?'Battery voltage':'Not available';}
async function update(){if(updateBusy||document.hidden||!appForeground)return;updateBusy=true;try{const r=await fetchTimed('/status',{cache:'no-store'});if(!r.ok)throw Error();const d=await r.json();if(d.sleeping&&!nativeApp&&!sleepPending){location.replace('/');return}updateVehicle(d);if(!sleepPending){setPowerState(d.sleeping);$('power-toggle').disabled=false}$('conn').className='connection online';$('conn').innerHTML='<span class="dot"></span>Connected';lastNetworkIp=d.ip||'';$('network').textContent=d.ip?'Network: '+d.ip:'Direct connection · '+d.wifi;if(currentLayout!==d.homeLayout){currentLayout=d.homeLayout;updateViews()}$('home-layout').value=d.homeLayout;$('home-style').value=d.homeStyle;$('boot-animation').checked=d.bootAnimation;if(currentTheme!==d.theme){currentTheme=d.theme;makeThemes()}if(currentView!==d.view){currentView=d.view;updateViews()}$('gear-status').textContent=!d.throttleValid?'Receiver disconnected':!d.gearCalibrated?'Calibration needed':'Command: '+(d.gearDirection==='D'?'Drive':d.gearDirection==='R'?'Reverse':'Neutral');$('tilt-status').textContent=d.tiltValid?'Park level before calibrating.':'Sensor not detected';for(const id of ['tilt-zero','settings-tilt-zero'])$(id).disabled=!d.tiltValid||$(id).dataset.feedbackBusy==='1';$('remote-connection').className='connection'+(d.throttleValid?' online':'');$('remote-connection').innerHTML='<span class="dot"></span>'+(d.throttleValid?'Connected':'Disconnected');$('remote-detail').textContent=d.throttleValid?'Receiver signal detected':'No receiver signal';$('track').textContent=d.track;$('artist').textContent=d.artist;const albumUrl='/album/'+d.art+'.jpg';if($('album-art').getAttribute('src')!==albumUrl)$('album-art').src=albumUrl;const time=n=>Math.floor(n/60)+':'+String(n%60).padStart(2,'0');$('track-time').textContent=time(d.position)+' / '+time(d.duration);$('play').textContent=d.playing?'Pause':'Play';$('shuffle').textContent=d.shuffle?'Shuffle on':'Shuffle off';$('shuffle').setAttribute('aria-pressed',String(d.shuffle));$('playlist').value=d.trackIndex;$('gps-status').textContent=d.gps?'Receiving phone location':'Waiting for the companion app';$('gps-status').className='caption'+(d.gps?' gps-on':'');$('gps-panel').textContent=d.gps?'Phone location is being sent to the Magoo display.':'Open the Magoo GPS app to send your phone’s location to the display.';if($('status').textContent.startsWith('Connecting'))$('status').textContent='';}catch(e){updateVehicle(null);$('tilt-zero').disabled=true;$('settings-tilt-zero').disabled=true;if(!sleepPending)$('power-toggle').disabled=true;$('conn').className='connection';$('conn').innerHTML='<span class="dot"></span>Not connected';$('network').textContent='Reconnect to MagooESP';$('remote-connection').className='connection';$('remote-connection').textContent='Unknown';$('remote-detail').textContent='Dashboard disconnected';$('status').textContent='Dashboard connection unavailable.'}finally{updateBusy=false}}update();setInterval(update,3000);
</script><script>// Guided Wi-Fi setup. Credentials never leave the browser except in the
// existing direct-to-device pairing request.
let pairData = {saved:[], networks:[], activeSlot:-1, setupAccess:false};
let pairMode = 0, pairSelection = null, pairStep = 'welcome', pairGeneration = 0;
let pairScanning = false, pairDifferentPassword = false;
const pairDialog = $('pairing');
const pairWifiIcon = '<svg viewBox="0 0 24 24" aria-hidden="true"><path d="M2 9a15 15 0 0 1 20 0M5 12a10 10 0 0 1 14 0M8 15a6 6 0 0 1 8 0"/><circle cx="12" cy="19" r="1"/></svg>';
const pairArrow = '<svg viewBox="0 0 24 24" aria-hidden="true"><path d="m9 5 7 7-7 7"/></svg>';

function pairShow(step) {
  pairStep = step;
  for (const el of pairDialog.querySelectorAll('[data-pair-screen]')) el.hidden = el.dataset.pairScreen !== step;
  const titles = {welcome:'Connect Magoo', setup:'Connect your phone', networks:'Choose a network', password:'Connect to Wi-Fi', connecting:'Connecting', success:'Connected', failed:'Connection help'};
  $('pair-header').textContent = titles[step] || 'Connect Magoo';
  $('pair-back').style.visibility = step === 'welcome' || step === 'connecting' ? 'hidden' : 'visible';
  pairDialog.scrollTop = 0;
  const heading = pairDialog.querySelector('[data-pair-screen="' + step + '"] h1');
  if (heading) heading.focus({preventScroll:true});
}
function pairUpdateModes() {
  for (let slot=0;slot<2;slot++) {
    const saved=pairData.saved.find(n=>n.slot===slot);
    $('pair-mode-'+slot).setAttribute('aria-pressed',String(pairMode===slot));
    $('pair-mode-note-'+slot).textContent = saved ? saved.ssid + (pairData.activeSlot===slot?' · Connected':' · Saved') : (slot===0?'For use around home':'For use away from home');
  }
}
async function pairLoad() {
  const response = await fetchTimed('/networks',{cache:'no-store'},3500);
  if (!response.ok) throw Error('Could not load networks');
  pairData = await response.json();
  pairData.saved = pairData.saved || [];
  pairData.networks = pairData.networks || [];
  pairUpdateModes();
  return pairData;
}
async function openPairing() {
  releaseWinch(); pairGeneration++; pairMode=0; pairSelection=null; pairDifferentPassword=false;
  pairShow('welcome');
  if (!pairDialog.open) pairDialog.showModal();
  try { await pairLoad(); } catch (_) { $('pair-welcome-status').textContent='Could not check saved networks. You can still continue.'; }
}
function closePairing() { pairGeneration++; $('pair-password').value=''; if(pairDialog.open)pairDialog.close(); ($( 'settings-dialog').open?$('wifi-open'):$('settings-open')).focus(); }
$('wifi-open').onclick=openPairing;
$('pair-close').onclick=closePairing;
pairDialog.addEventListener('cancel',event=>{event.preventDefault();closePairing()});
for (const slot of [0,1]) $('pair-mode-'+slot).onclick=()=>{pairMode=slot;pairUpdateModes()};
$('pair-continue').onclick=async()=>{
  try { await pairLoad(); } catch (_) { pairShow('setup'); return; }
  if (!pairData.setupAccess) { pairShow('setup'); return; }
  await pairEnterNetworks();
};
$('pair-open-setup').onclick=()=>{location.href='http://192.168.4.1/'};
$('pair-back').onclick=()=>{
  if(pairStep==='password'){pairShow('networks');return}
  if(pairStep==='networks'||pairStep==='setup'||pairStep==='success'||pairStep==='failed'){pairShow('welcome');return}
};

function pairAddNetwork(name, saved, network) {
  const row=document.createElement('button'); row.type='button';row.className='pair-choice';row.disabled=pairScanning;
  const icon=document.createElement('span');icon.className='pair-icon';icon.innerHTML=pairWifiIcon;
  const text=document.createElement('span');text.className='pair-copy';
  const title=document.createElement('strong');title.textContent=name;
  const sub=document.createElement('small');
  sub.textContent=saved ? (pairData.activeSlot===pairMode?'Connected · saved':'Saved network') : (network.secured?'Password required':'Open network');
  text.append(title,sub);const arrow=document.createElement('span');arrow.className='pair-chevron';arrow.innerHTML=pairArrow;
  row.append(icon,text,arrow);
  row.onclick=()=>{pairSelection={ssid:name,slot:pairMode,saved:!!saved,secured:network?!!network.secured:true};pairDifferentPassword=false;pairPasswordScreen()};
  $('pair-networks-list').append(row);
}
function pairRenderNetworks() {
  const list=$('pair-networks-list');list.replaceChildren();
  const saved=pairData.saved.find(n=>n.slot===pairMode);
  if(saved)pairAddNetwork(saved.ssid,true,pairData.networks.find(n=>n.ssid===saved.ssid));
  for(const n of pairData.networks)if(!saved||n.ssid!==saved.ssid)pairAddNetwork(n.ssid,false,n);
  if(!list.children.length&&!pairScanning){const note=document.createElement('p');note.className='pair-note';note.textContent='No networks found. Make sure your network or hotspot is on, then search again.';list.append(note)}
  $('pair-scan').disabled=pairScanning;
}
async function pairEnterNetworks(){
  pairShow('networks');$('pair-network-subtitle').textContent=pairMode===0?'Choose your home Wi-Fi network.':'Choose your phone’s hotspot.';
  $('pair-network-hint').textContent=pairMode===0?'Magoo supports 2.4 GHz Wi-Fi.':'Keep the hotspot on. If this phone can’t use its hotspot and connect to Magoo at the same time, use another phone for setup.';
  pairRenderNetworks();await pairScan();
}
async function pairScan(){
  if(pairScanning)return;pairScanning=true;const generation=pairGeneration;
  $('pair-scan-status').innerHTML='<span class="pair-spinner" aria-hidden="true"></span>Looking for networks…';pairRenderNetworks();
  try {
    const response=await fetchTimed('/scan',{method:'POST'},5000);
    if(response.status===403){pairShow('setup');return}
    if(response.status===409){$('pair-scan-status').textContent='Magoo is connecting. Try searching again in a moment.';return}
    if(!response.ok)throw Error('scan');
    for(let i=0;i<35&&generation===pairGeneration;i++){
      await new Promise(resolve=>setTimeout(resolve,1000));
      const data=await pairLoad();
      if(!data.scanning){$('pair-scan-status').textContent='Showing nearby 2.4 GHz networks.';return}
    }
    if(generation===pairGeneration)throw Error('timeout');
  } catch(_){if(generation===pairGeneration)$('pair-scan-status').textContent='Couldn’t search. Your saved network is still shown.'}
  finally {pairScanning=false;if(generation===pairGeneration)pairRenderNetworks()}
}
$('pair-scan').onclick=pairScan;
function pairPasswordScreen(){
  $('pair-selected-name').textContent=pairSelection.ssid;
  $('pair-selected-detail').textContent=pairSelection.saved?'Saved network':pairSelection.secured?'Password-protected network':'Open network';
  $('pair-password').value='';$('pair-password').type='password';$('pair-show-password').textContent='Show';
  $('pair-password-area').hidden=pairSelection.saved||!pairSelection.secured;
  $('pair-saved-note').hidden=!pairSelection.saved;
  $('pair-change-password').hidden=!pairSelection.saved;
  $('pair-form-error').textContent='';pairShow('password');
}
$('pair-change-password').onclick=()=>{pairDifferentPassword=true;$('pair-password-area').hidden=false;$('pair-saved-note').hidden=true;$('pair-change-password').hidden=true;$('pair-password').focus()};
$('pair-show-password').onclick=()=>{const field=$('pair-password'),show=field.type==='password';field.type=show?'text':'password';$('pair-show-password').textContent=show?'Hide':'Show';$('pair-show-password').setAttribute('aria-label',show?'Hide password':'Show password')};
$('pair-form').onsubmit=async event=>{
  event.preventDefault();if(!pairSelection)return;
  const password=$('pair-password').value,useSaved=pairSelection.saved&&!pairDifferentPassword;
  if(!useSaved&&pairSelection.secured&&(password.length<8||password.length>63)){$('pair-form-error').textContent='Enter a Wi-Fi password between 8 and 63 characters.';return}
  const selection=pairSelection,generation=++pairGeneration,pairId=Math.floor(Math.random()*4294967295)+1;
  pairShow('connecting');$('pair-connecting-name').textContent=selection.ssid;
  let requestAccepted=false;
  try {
    const response=await fetchTimed('/wifi',{method:'POST',headers:{'Content-Type':'application/x-www-form-urlencoded'},body:new URLSearchParams({ssid:selection.ssid,password,slot:String(selection.slot),useSaved:useSaved?'1':'0',pairId:String(pairId)})},5000);
    if(response.status===403){pairShow('setup');return}
    if(response.status===409){pairFailure('Magoo is busy connecting or searching. Wait a moment, then try again.');return}
    if(!response.ok){pairFailure('Check the network details and try again.');return}
    requestAccepted=true;
  } catch(_) { /* Switching Wi-Fi can interrupt the response; check the device. */ }
  finally {$('pair-password').value=''}
  const deadline=Date.now()+40000;
  while(generation===pairGeneration&&Date.now()<deadline){
    await new Promise(resolve=>setTimeout(resolve,1000));
    try {
      const data=await pairLoad();
      if(data.pairingSlot!==selection.slot||data.pairingId!==pairId)continue;
      if(data.pairing==='connected'){pairShow('success');$('pair-success-name').textContent=selection.ssid;return}
      if(data.pairing==='failed'){pairFailure('Magoo couldn’t join that network. Check the password and make sure it’s a 2.4 GHz network.');return}
    } catch(_) { /* The setup Wi-Fi can briefly disappear when channels change. */ }
  }
  if(generation===pairGeneration)pairFailure(requestAccepted?'The connection changed before Magoo could confirm. Reconnect your phone to MagooESP, open 192.168.4.1, and check Wi-Fi setup.':'We couldn’t confirm that Magoo received the request. Reconnect to MagooESP and try again.');
};
function pairFailure(message){$('pair-failure-message').textContent=message;pairShow('failed')}
$('pair-done').onclick=closePairing;
$('pair-try-again').onclick=()=>pairShow('welcome');
</script></body></html>

)MAGOOHTML";
const char STANDBY_PAGE[] PROGMEM = R"MAGOOSTANDBY(<!doctype html>
<html lang="en"><head><meta charset="utf-8"><meta name="viewport" content="width=device-width,initial-scale=1,viewport-fit=cover"><meta name="theme-color" content="#090a0b"><title>Magoo · Get connected</title><style>
:root{color-scheme:dark}*{box-sizing:border-box}body{margin:0;min-height:100dvh;display:grid;place-items:center;background:#090a0b;color:#f6f6f6;font-family:system-ui,-apple-system,Segoe UI,sans-serif;padding:24px}.standby{width:min(100%,420px);text-align:center}.mark{display:grid;place-items:center;margin:auto auto 28px;width:76px;height:76px;border:1px solid #45484a;border-radius:24px;background:linear-gradient(145deg,#212224,#141517);color:#e56c74}.mark svg{width:36px;height:36px;fill:none;stroke:currentColor;stroke-width:1.7;stroke-linecap:round;stroke-linejoin:round}.eyebrow{font-size:10px;color:#a9aaad;font-weight:700;letter-spacing:.18em}h1{font-size:30px;letter-spacing:-.035em;margin:12px 0}.caption{color:#a8aaad;font-size:14px;line-height:1.5;margin:0 auto 30px;max-width:310px}.actions{display:grid;gap:10px}.download{min-height:54px;border-radius:12px;background:#c2242e;color:white;border:1px solid #e23c47;font-size:15px;font-weight:700;display:grid;place-items:center;padding:12px;text-decoration:none}.web-link{display:flex;align-items:center;justify-content:center;min-height:44px;color:#a8aaad;font-size:13px;text-decoration:underline;text-underline-offset:3px;cursor:pointer}.web-link[aria-disabled="true"]{opacity:.6;cursor:wait}.message{font-size:12px;color:#f28c94;margin:14px 0 0;min-height:18px}a:focus-visible{outline:2px solid white;outline-offset:3px}
</style></head><body><main class="standby"><div class="mark" aria-hidden="true"><svg viewBox="0 0 24 24"><rect x="6" y="2" width="12" height="20" rx="2"/><path d="M10 5h4M11 19h2"/></svg></div><div class="eyebrow">MAGOO WEB DASHBOARD</div><h1>Hey!</h1><p class="caption">The Android app keeps the dashboard on your phone, reducing work for your ESP32.</p><div class="actions"><a class="download" href="https://magoo.dexifyz.com/">Download App (Recommended)</a><a class="web-link" id="wake" href="/">I want to use the web dashboard anyways</a></div><p class="message" id="message" role="status"></p></main><script>
const wake=document.getElementById('wake'),message=document.getElementById('message');let waking=false;
wake.addEventListener('click',async event=>{event.preventDefault();if(waking)return;waking=true;wake.setAttribute('aria-disabled','true');message.textContent='';try{const response=await fetch('/sleep',{method:'POST',headers:{'Content-Type':'application/x-www-form-urlencoded'},body:'sleep=0&web=1'});if(!response.ok)throw Error();location.replace('/')}catch(_){message.textContent='Couldn’t open the dashboard. Check your connection and try again.';waking=false;wake.removeAttribute('aria-disabled')}});
async function check(){if(document.hidden||waking)return;try{const response=await fetch('/status',{cache:'no-store'});if(response.ok){const state=await response.json();if(!state.sleeping&&state.webUnlocked)location.replace('/')}}catch(_){}}
setInterval(check,5000);document.addEventListener('visibilitychange',()=>{if(!document.hidden)check()});
</script></body></html>
)MAGOOSTANDBY";
const uint8_t DASHBOARD_PAGE_GZIP[] PROGMEM = {
31,139,8,0,0,0,0,0,2,255,213,189,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0
};
const size_t DASHBOARD_PAGE_GZIP_SIZE = sizeof(DASHBOARD_PAGE_GZIP);
const uint8_t DASHBOARD_HERO[] PROGMEM = {
255,216,255,224,0,16,74,70,73,70,0,1,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217
};
const size_t DASHBOARD_HERO_SIZE = sizeof(DASHBOARD_HERO);
